#include "display.h"

Adafruit_SSD1306 display(SCREEN_WIDTH, SCREEN_HEIGHT, &Wire, OLED_RESET);

const unsigned char cKitty [] PROGMEM = {
  // 'calamity-kitten-ssd1306', 128x64px
  0xff, 0xff, 0xff, 0xff, 0xff, 0xff, 0xff, 0xff, 0xff, 0xff, 0xff, 0xff, 0xff, 0xff, 0xff, 0xff, 
  0xff, 0xff, 0xff, 0xff, 0xff, 0xff, 0xff, 0xff, 0xff, 0xff, 0xff, 0xff, 0xff, 0xff, 0xff, 0xff, 
  0xff, 0xff, 0xff, 0xff, 0xff, 0xff, 0xff, 0xff, 0xff, 0xff, 0xff, 0xff, 0xff, 0xff, 0xff, 0xff, 
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  0xff, 0xff, 0xff, 0xff, 0xff, 0xff, 0xff, 0xff, 0xff, 0xff, 0xff, 0xff, 0xff, 0xff, 0xff, 0xff
};

void initDisplay() {
  // Serial.begin(115200);

  // SSD1306_SWITCHCAPVCC = generate display voltage from 3.3V internally
  if(!display.begin(SSD1306_SWITCHCAPVCC, 0x3C)) { 
    Serial.println("SSD1306 allocation failed");
    setButtonLED({.r = 1.0, .g = 0.0, .b = 0.0});
    while(1) delay(1000);
  }

  display.setRotation(2);

  displaySplash();
}

void displaySplash() {
  display.clearDisplay();
  display.drawBitmap(0, 0, cKitty, 128, 64, WHITE, BLACK);
  display.display();

  delay(1000);
}

void updateDisplay() {
  unsigned char gameMode = getGameMode();
  display.clearDisplay();
  display.setTextSize(1);
  display.setTextColor(WHITE);
  display.setCursor(0, 4);

  switch(gameMode) {
    case GAME_MODE_OFF:
      updateDisplay_NoGame();
      break;
    case GAME_MODE_BASIC_STATIC:
      updateDisplay_BasicStatic();
      break;
    case GAME_MODE_BASIC_RANDOM:
      updateDisplay_BasicRandom();
      break;
  }

  display.display();
}

void updateDisplay_NoGame() {
  display.println("No game running!");
  display.printf("\n\n\n\n");
  display.printf("IP Address:\n%21s", WiFi.localIP().toString());
}

void updateDisplay_BasicStatic() {
  display.println("Mode: Static");
  unsigned int nextPress = getNextPress();
  if (nextPress < millis()) {
    display.printf("Live reaction:\n  %s\n", formatTime(millis() - nextPress));
  } else {
    display.printf("Next press:\n  %s\n", formatTime(nextPress - millis()));
  }
}

void updateDisplay_BasicRandom() {
  display.println("Mode: Random");
  unsigned int nextPress = getNextPress();
  if (nextPress < millis()) {
    display.printf("Live reaction:\n  %s\n", formatTime(millis() - nextPress));
  } else {
    display.printf("Next press:\n  %s\n", formatTime(nextPress - millis()));
  }
}

String formatTime(unsigned int time) {
  String output = "";

  output = String(time % 1000) + output;
  if (time % 1000 < 100) output = "0" + output;
  if (time % 1000 < 10) output = "0" + output;

  time /= 1000;
  output = String(time % 60) + "." + output;
  if (time % 60 < 10) output = "0" + output;
  
  time /= 60;
  output = String(time % 60) + ":" + output;
  if (time % 60 < 10) output = " " + output;
  if (time % 60 < 100) output = " " + output;
  if (time % 60 < 1000) output = " " + output;
  if (time % 60 < 10000) output = " " + output;

  return output;
}